/*
 * this file is ued to change sprd dtsi which can't be changed by overlay
 * such as /delete-node/ /delete-property/ and alises
 */

#include "zte_touchscreen.dtsi"
#include "zte_audio.dtsi"
#include "zte_sar.dtsi"
#include "zte_nfc_thn31.dtsi"
#include "zte_camera_sudates.dtsi"
#include "zte_charger_sudates.dtsi"
#include "zte_fingerprint.dtsi"
#include "../../thermal/ntc-nr.dtsi"

/{
        zcard_holder_det {
                zcard-holder-det-gpios= <&eic_sync 36 GPIO_ACTIVE_HIGH>;
        };
};


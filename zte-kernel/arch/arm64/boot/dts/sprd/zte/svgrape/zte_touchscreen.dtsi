&spi1 {
	status = "okay";
	#address-cells = <1>;
	#size-cells = <0>;
	/delete-node/ touchpanel@0;
	zte-ts@0 {
		compatible = "eswin,eph861x", "focaltech,fts";
		reg = <0x00>;
		spi-max-frequency = <6000000>;

		eswin,use-power-gpio;
		eswin,power-gpio = <&ap_gpio 60 0x0000>;
		eswin,use-avdd-supply;
		avdd-supply = <&vddcammot1>;
		eswin,regulator_avdd = "avdd";
		eswin,avdd-voltage = <1800000>;

		eswin,irq-gpio = <&eic_async 16 0x2008>;
		eswin,reset-gpio = <&ap_gpio 14 0x0000>;

		eswin,suspend-mode = <0x02>;
		eswin,panel-invert-x = <0>;
		eswin,panel-invert-y = <1>;
		eswin,panel-max-x = <1079>;
		eswin,panel-max-y = <2391>;

		focal,use-pwr-gpio;
		focaltech,pwr-gpio = <&ap_gpio 60 0x0000>;
		focal,use-iovdd-supply;
		iovdd-supply = <&vddcammot1>;
		focal,iovdd-voltage = <1800000>;

		focaltech,reset-gpio = <&ap_gpio 14 0x0000>;
		focaltech,irq-gpio =  <&eic_async 16 0x2008>;
		focaltech,max-touch-number = <10>;
		focaltech,display-coords =  <0 0 1079 2391>;
 	};
};

/{
	zte_tp:zte_tp {
		compatible = "zte_tp";
		zte,tp_algo;
		zte,tp_long_press;
		zte,tp_long_press_timer = <800>;
		zte,tp_long_press_left_v = <12>;
		zte,tp_long_press_right_v = <12>;
		zte,tp_long_press_left_h = <16>; /*camera */
		zte,tp_long_press_right_h = <12>; /*charger */
		zte,tp_edge_click_suppression_pixel = <0>;
		zte,ufp_enable;
		zte,ufp_circle_center_x = <540>;
		zte,ufp_circle_center_y = <2176>;
		zte,ufp_circle_radius = <92>;
		zte,ghost_check_config;
		zte,ghost_check_single_time = <25>;
		zte,ghost_check_multi_time = <20>;
		zte,ghost_check_single_count = <5>;
		zte,ghost_check_multi_count = <8>;
		zte,ghost_check_start_time = <30>;
		zte,ghost_check_ignore_id = <9>;
	};

};

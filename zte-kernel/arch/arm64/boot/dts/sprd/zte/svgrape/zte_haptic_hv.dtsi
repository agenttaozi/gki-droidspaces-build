/***************** AWINIC High Voltage Haptic Driver ****************/
//&pin_controller {
//	haptic_hv_input_pull_up: haptic_hv_input_pull_up {
//		pins = "QOGIRN6PRO_IIS3DI";
//		function = "func4";
//	};
//
//	haptic_hv_reset_active: haptic_hv_reset_active {
//		pins = "QOGIRN6PRO_IIS1LRCK";
//		function = "func4";
//	};
//};

&i2c5 {
	status = "okay";
	#address-cells = <1>;
	#size-cells = <0>;
	clock-frequency = <1000000>;
	haptic_hv@5A {
		compatible = "awinic,haptic_hv";
		reg = <0x5A>;
		irq-gpio = <&ap_gpio 191 0>;
		reset-gpio = <&ap_gpio 181 0>;
		//pinctrl-names = "default", "irq_active";
		//pinctrl-0 = <&haptic_hv_reset_active>, <&haptic_hv_input_pull_up>;
		//pinctrl-1 = <&haptic_hv_input_pull_up>;
		f0_pre = < 2350 >;
		mode = /bits/ 8 < 1 >;
		f0_cali_percent = /bits/ 8 < 7 >;
/******************************aw8692x*******************************/
		aw8692x_max_bst_vol = /bits/ 8 < 0x7F >;
		aw8692x_cont_drv1_lvl = /bits/ 8 < 0x7F >;
		aw8692x_cont_drv2_lvl = /bits/ 8 < 0x50 >;
		aw8692x_cont_drv1_time = /bits/ 8 < 0x04 >;
		aw8692x_cont_drv2_time = /bits/ 8 < 0x0C >;
		aw8692x_cont_drv_width = /bits/ 8 < 0x4A >;
		aw8692x_cont_wait_num = /bits/ 8 < 0x06 >;
		aw8692x_cont_brk_time = /bits/ 8 < 0 >;
		aw8692x_cont_track_margin = /bits/ 8 < 0x0C >;
		aw8692x_brk_bst_md = /bits/ 8 < 0 >;
		aw8692x_cont_tset = /bits/ 8 < 0x06 >;
		aw8692x_cont_bemf_set = /bits/ 8 < 0x02 >;
		aw8692x_cont_bst_brk_gain = /bits/ 8 < 0x05 >;
		aw8692x_cont_brk_gain = /bits/ 8 < 0x08 >;
		aw8692x_duration_time = /bits/ 8 < 20 30 60 >;
		aw8692x_d2s_gain = /bits/ 8 < 0x04 >;
		aw8692x_trig_config = /bits/ 8 < 0 0 0 1 0 2 0 0
						 0 0 0 1 0 2 0 0
						 0 0 0 1 0 2 0 0 >;
		aw8692x_bst_vol_default = /bits/ 8 < 0x48 >;
		aw8692x_bst_vol_ram = /bits/ 8 < 0x48 >;
		aw8692x_bst_vol_rtp = /bits/ 8 < 0x48 >;
		aw8692x_gain = /bits/ 8 < 0x25 >;
		/* aw8692x_is_enabled_auto_bst; */
		/* aw8692x_is_enabled_one_wire; */
	};
};
/************************** AWINIC END *****************************/

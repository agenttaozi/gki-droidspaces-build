&spi1 {
	status = "okay";
	#address-cells = <1>;
	#size-cells = <0>;
	/delete-node/ touchpanel@0;
	zte-ts@0 {
		compatible = "novatek,NVT-ts-spi", "focaltech,fts";
		reg = <0>;
		spi-max-frequency = <9600000>;

		novatek,irq-gpio = <&eic_async 16 0x0000>;
		novatek,reset-gpio = <&ap_gpio 14 0x0000>;

		novatek,pen-support;

		focaltech,reset-gpio = <&ap_gpio 14 0x0000>;
		focaltech,irq-gpio = <&eic_async 16 0x2008>;
		focaltech,max-touch-number = <10>;
		focaltech,display-coords =  <0 0 1319 2111>;
 	};
};

/{
	zte_tp:zte_tp {
		compatible = "zte_tp";
		zte,tp_algo;
		zte,tp_long_press;
		zte,tp_long_press_timer = <800>;
		zte,tp_long_press_left_v = <0>;
		zte,tp_long_press_right_v = <0>;
		zte,tp_long_press_left_h = <0>; /*camera */
		zte,tp_long_press_right_h = <0>; /*charger */
		zte,tp_edge_click_suppression_pixel = <0>;
		zte,ghost_check_config;
		zte,ghost_check_single_time = <25>;
		zte,ghost_check_multi_time = <20>;
		zte,ghost_check_single_count = <5>;
		zte,ghost_check_multi_count = <8>;
		zte,ghost_check_start_time = <35>;
		zte,ghost_check_ignore_edge_area = <41>;
		zte,ghost_check_ignore_corner_x = <121>;
		zte,ghost_check_ignore_corner_y = <121>;
	};
};
&i2c2 {
	status = "okay";
        #address-cells = <1>;
        #size-cells = <0>;
        thn31_nfc@29 {
                compatible = "tms,nfc";
                reg = <0x29>;
                interrupt-parent = <&ap_gpio>;
                interrupts = <9 0>;
                tms,device-name = "tms_nfc";
                tms,device-count = <1>;
                tms,irq-gpio = <&ap_gpio 127 0>;
                tms,clkreq-gpio = <&ap_gpio 147 0>;
                tms,ven-gpio = <&ap_gpio 149 1>;
                interrupt-names = "nfc_int";
        };
};

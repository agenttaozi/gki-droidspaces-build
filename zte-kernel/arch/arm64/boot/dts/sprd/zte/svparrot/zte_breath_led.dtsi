&i2c9 {
	status = "okay";
	aw21024_led@30 {
		compatible = "awinic,aw21024_led";
		reg = <0x30>;
		reset-gpio = <&ap_gpio 195 0x0000>;
		apse_mode;
		/* 0:16M 1:8M 2:1M 3:512K 4:256K 5:125K 6:62K 7:31K */
		clk_pwm = <1>;
		/* 255 1023 2047 */
		max_brightness = <255>;
		led_current = <125>;
		brightness = <125>;
	};
};

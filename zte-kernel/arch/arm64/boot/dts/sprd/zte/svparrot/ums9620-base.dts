/*****************************************
Do not modify dts file, please modify according dtsi file
******************************************/
#include "../../ums9620-base.dts"
#include "sprd_base_diff.dtsi"



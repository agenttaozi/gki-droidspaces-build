## zte-kernel/drivers/vendor/common/Kconfig
```kconfig
config VENDOR_COMMON_COMPILE
	bool "drivers/vendor/common drivers compile control"
	default n
	help
	  This enables drivers/vendor/common drivers to be compiled.

config VENDOR_SOC_QCOM_COMPILE
	bool "drivers/vendor/soc/qcom drivers compile control"
	default n
	help
	  This enables drivers/vendor/soc/qcom drivers to be compiled.

config VENDOR_SOC_MTK_COMPILE
	bool "drivers/vendor/soc/mediatek drivers compile control"
	default n
	help
	  This enables drivers/vendor/soc/mediatek drivers to be compiled.

config VENDOR_SOC_SPRD_COMPILE
	bool "drivers/vendor/soc/sprd drivers compile control"
	default n
	help
	  This enables drivers/vendor/soc/sprd drivers to be compiled.

config SOC_QCOM
	bool "qcom common drivers"
	default n
	help
	  This enables support for common driver in qcom platform.

config SOC_MTK
	bool "MTK common drivers"
	default n
	help
	  This enables support for common driver in MTK platform.

config SOC_SPRD
	bool "spred common drivers"
	default n
	help
	  This enables support for common driver in sprd platform.

config VENDOR_SQC_CHARGER
	bool "sqc charger platform common drivers"
	default n
	help
	  This enables support for platform sqc common driver.

source "drivers/vendor/common/touchscreen_v2/Kconfig"
source "drivers/vendor/common/nxp_tfa9894/Kconfig"
source "drivers/vendor/common/power/Kconfig"
source "drivers/vendor/common/sqc/Kconfig"
source "drivers/vendor/common/sqc_v2/Kconfig"
source "drivers/vendor/common/sqc_base/Kconfig"
source "drivers/vendor/common/sqc_v7/Kconfig"
source "drivers/vendor/common/vcfg/Kconfig"
source "drivers/vendor/common/awinic/Kconfig"
source "drivers/vendor/common/tfa9873/Kconfig"
source "drivers/vendor/common/sensor/Kconfig"
source "drivers/vendor/common/leds/Kconfig"
source "drivers/vendor/common/zlog/Kconfig"
source "drivers/vendor/common/sqc_v8/Kconfig"
source "drivers/vendor/common/sqc_sprd/Kconfig"
source "drivers/vendor/common/zcard_det/Kconfig"
source "drivers/vendor/common/crypto_chip/Kconfig"

##### Fingerprint #####
source "drivers/vendor/common/fingerprint/Kconfig"
#lcd
source "drivers/vendor/common/zte_lcdbl/Kconfig"
source "drivers/vendor/common/zte_lt8911exb_mipi_to_edp/Kconfig"

source "drivers/vendor/common/stats_info/Kconfig"
source "drivers/vendor/common/zte_pv_pintest/Kconfig"
#ZTE_AUDIO
source "drivers/vendor/common/aw883xx/Kconfig"
source "drivers/vendor/common/aw883xx_new/Kconfig"
source "drivers/vendor/common/aw87xxx/Kconfig"
source "drivers/vendor/common/aw87xxx_87391_87565/Kconfig"
source "drivers/vendor/common/fs1599/Kconfig"
source "drivers/vendor/common/fs1815/Kconfig"
source "drivers/vendor/common/tfa9894/Kconfig"
source "drivers/vendor/common/tas2563/Kconfig"
source "drivers/vendor/common/aw87394/Kconfig"
#ZTE_EMMC
source "drivers/vendor/common/zte_emmc_info/Kconfig"

#USB
source "drivers/vendor/common/pidpx1217/Kconfig"
source "drivers/vendor/common/whs3844/Kconfig"

#ZTE_SYS_F2FS
source "drivers/vendor/common/zte_sys_f2fs/Kconfig"

#HAPTIC HV
source "drivers/vendor/common/aw_haptic_hv/Kconfig"

#LIDON
source "drivers/vendor/common/notebook_poweron_with_lidon/Kconfig"

#zte add begin
config ZTE_DUAL_HPH
	tristate "ZTE Dual 3.5mm headphone"
	default n
	help
	  Say Y here, if supported dual 3.5mm headphone

config ZTE_SND_SOC_FSM1512N
	bool "ZTE_SND_SOC_FSM1512N common drivers"
	default n
	help
		This enables support for ZTE_SND_SOC_FSM1512N common driver.

config ZTE_SND_SOC_FS1559N
	bool "ZTE_SND_SOC_FS1559N common drivers"
	default n
	help
		This enables support for ZTE_SND_SOC_FS1559N common driver.
#zte add  end
```

## zte-kernel/drivers/vendor/common/fingerprint/microarray/Kconfig
```kconfig
#
# microarray Fingerprint driver configuration
#

config PLATFORM_FINGERPRINT_MICROARRAY
       bool "generic microarray E026L fingerprint driver"
       default n
       help
       add support for microarray fingerprint driver.
```

## zte-kernel/drivers/vendor/common/fs1599/Kconfig
```kconfig
config ZTE_SND_SOC_FS1599
        tristate "SoC Audio for FourSemi PA FS1599N"
        depends on I2C
    help
        This option enables support for FourSemi PA.


config ZTE_SND_SOC_FSMXXX_USE_SCENE_SWITCH
        tristate "SoC Audio for FourSemi PA SCENE SWITCH"
        depends on I2C
    help
        This option enables support for FourSemi PA.
```

## zte-kernel/drivers/vendor/common/fs1815/Kconfig
```kconfig
config ZTE_SND_SOC_CODEC_FS1815N
        tristate "SoC Audio for FourSemi PA FS1599N"
        depends on I2C
    help
        This option enables support for FourSemi PA.

config ZTE_SND_SOC_CODEC_FS1815N_DOUBLE
        tristate "SoC Audio for FourSemi PA FS1599N double"
        depends on I2C
    help
        This option enables support for FourSemi PA double.
```

## zte-kernel/drivers/vendor/common/leds/aw21024/Kconfig
```kconfig
config ZTE_LEDS_AW21024
	tristate "LED Support for AW21024"
	depends on I2C
	default n
	help
		this option enables support for the AW21024 RGB LED connected
		through I2C. Say Y to enable support for the AW21024 LED
		light automatically.
```

## zte-kernel/drivers/vendor/common/notebook_poweron_with_lidon/Kconfig
```kconfig
config NB_POWERON_WITH_LIDON
	tristate "ZTE Notebook Poweron With Lidon support"
	help
		This option enable ZTE  Notebook Poweron With Lidon and interface.
```

## zte-kernel/drivers/vendor/common/pidpx1217/Kconfig
```kconfig
config REDRIVER_PIDPX1217
	tristate "PIDPX1217 Driver"
	help
	  Enable this to support QOGIRN6PRO USB3 PHY . This
	  driver is redriver for usb3.0.
```

## zte-kernel/drivers/vendor/common/sensor/hall/Kconfig
```kconfig
config HALL_SENSOR_AH1898
	tristate "HALL_SENSOR_AH1898"
		default n
		help
			Say Y here to build support for hall.
			To compile this driver as a module, choose M here.

config HALL_SENSOR_AK09973
	tristate "HALL_SENSOR_AK09973"
		default n
		help
			Say Y here to build support for ak09973.
			To compile this driver as a module, choose M here.

config HALL_POWEROFF_CHG_REPORT_KEY_EVENT
	bool "HALL_POWEROFF_CHG_REPORT_KEY_EVENT"
		default n
		help
			Say Y here to build support for hall report key event in poweroff charging.
			To compile this driver as a module, choose M here.
```

## zte-kernel/drivers/vendor/common/sensor/sar_t/Kconfig
```kconfig
config SAR_SENSOR_T_AW9610X
	tristate "SAR_SENSOR_T_AW9610X"
		depends on I2C
		default n
		help
			Say Y here to build support for sensor hub new.
			To compile this driver as a module, choose M here.

config SAR_SENSOR_T_AW9610X_2
	tristate "SAR_SENSOR_T_AW9610X_2"
		depends on I2C
		default n
		help
			Say Y here to build support for sensor hub new.
			To compile this driver as a module, choose M here.

config SAR_SENSOR_T_STK501XX
	tristate "SAR_SENSOR_T_STK501XX"
		depends on I2C
		default n
		help
			Say Y here to build support for sensor hub new.
			To compile this driver as a module, choose M here.

config SAR_SENSOR_T_STK501XX_2
	tristate "SAR_SENSOR_T_STK501XX_2"
		depends on I2C
		default n
		help
			Say Y here to build support for sensor hub new.
			To compile this driver as a module, choose M here.

source "drivers/vendor/common/sensor/sar_t/aw9610x/Kconfig"
```

## zte-kernel/drivers/vendor/common/sqc_sprd/Kconfig
```kconfig
# SPDX-License-Identifier: GPL-2.0-only
config VENDOR_SQC_MODULE
	tristate "sqc power policy"
	help
	  Say Y here, if supported zte sqc charger

config VENDOR_SQC_CHARGER_SPRD
	bool "sqc power sprd"
	default n
	help
	  Say Y here, if supported zte sqc charger sprd

config VENDOR_SQC_NETLINK
	tristate "sqc power NETLINK"
	help
	  Say Y here, if supported zte sqc charger NETLINK

config VENDOR_SQC_BQ2560X
	tristate "sqc power bq2560x"
	help
	  Say Y here, if supported zte sqc charger BQ2560X

config VENDOR_SQC_BQ25890
	tristate "sqc power bq25890"
	help
	  Say Y here, if supported zte sqc charger BQ25890

config VENDOR_SQC_BQ2597X
	tristate "sqc power bq2597x"
	help
	  Say Y here, if supported zte sqc charger bq2597x

config VENDOR_SQC_SC8989X
	tristate "sqc power sc8989x"
	default n
	help
	  Say Y here, if supported zte sqc charger sc8989x

config VENDOR_SQC_SGM41510
	tristate "sqc power sgm41510"
	default n
	help
	  Say Y here, if supported zte sqc charger sgm41510

config VENDOR_SQC_HL7009
	tristate "sqc power hl7009"
	default n
	help
	  Say Y here, if supported zte sqc charger hl7009

config SC888X_CHARGER
	tristate "SC8886X Buck Boost Charger driver"
	default n
	help
		If you say yes here you will get support for the SC8886/SC8886S/SC8886A/SC8885/SC8885S/SC8885A Buck Boost Charger.
		This driver can give support for SC8886/SC8886S Interface.

config LT8711_DP_TO_HDMI
	tristate "lt877 hdmi to dp driver"
	default n
	help
		If you say yes here you will get support for the lt877 hdmi to dp driver.
		This driver can give support for lt877 Interface.

config VENDOR_SQC_QC3PLUS
	tristate "use qc3 detect chip"
	default n
	help
	  Say Y here to enable the "QC3 DETECT CHIP" driver

config SMART_BATTERY
       tristate "smart battery driver"
       depends on REGMAP_I2C
       help
         Say Y to enable support for the smart battery.
config VENDOR_SQC_NU2115
        tristate "NU2115 Charger Pump driver"
        help
          If you say yes here you will get support for the NU2115 Charge Pump.
          This driver can give support for NU2115 Interface.

config VENDOR_SQC_SC8541
        tristate "SC8541 Charger Pump driver"
        help
          If you say yes here you will get support for the SC8541 Charge Pump.
          This driver can give support for SC8541 Interface.

config VENDOR_SQC_UPM6720
        tristate "UPM6720 Charger Pump driver"
        help
          If you say yes here you will get support for the UPM6720 Charge Pump.
          This driver can give support for UPM6720 Interface.

config VENDOR_SQC_SD76930
	tristate "sqc power sd76930"
	default n
	help
	  Say Y here, if supported zte sqc charger sd76930

config VENDOR_SQC_ETA6937
	tristate "sqc power eta6937"
	default n
	help
	  Say Y here, if supported zte sqc charger eta6937

config OTG_NAME_COMPLITE
	bool "otg desc name control"
	default n
	help
	  Say Y here, if supported otg desc name control

config BQ2560X_BQ25890_SUPPORT
	bool "whether use bq2560x and bq25890 in same project"
	default n
	help
	  Say Y here, if supported bq2560x and bq25890 each IC
```

## zte-kernel/drivers/vendor/common/stats_info/Kconfig
```kconfig
config VENDOR_STATS_INFO
	tristate "ZTE STATS INFO"
	help
	  Say 'y' here to include support for zte stats info.
```

## zte-kernel/drivers/vendor/common/tas2563/Kconfig
```kconfig
config ZTE_SND_SOC_TASDEVICE_2563
	tristate "Texas Instruments TASDEVICE  2563"
	select REGMAP
	select REGMAP_I2C
	select I2C
	select SYSFS
	select CONFIG_SOUND
	help
	Enable support Texas Instruments tasdevice
	To compile this driver as a module, choose M here
	If unsure select "N"
```

## zte-kernel/drivers/vendor/common/tfa9894/Kconfig
```kconfig
config ZTE_SND_SOC_TFA9894
	bool "Support Goodix smartpa driver"
	depends on I2C = y && REGMAP = y

	help
	  Select this option to enable support for Goodix smartpa driver tfa98xx

config SND_SOC_TFAHAPTIC
	tristate  "Support Goodix haptic driver"
	depends on I2C = y && REGMAP = y
	default y
	help
	  Select this option to enable support for Goodix haptic driver for TFA9873/4
config ZTE_SND_SOC_TFA9894_SUPER_VOL
	tristate  "Support super volume"
```

## zte-kernel/drivers/vendor/common/touchscreen_v2/Kconfig
```kconfig
#
# Touchscreen driver configuration
#
config TOUCHSCREEN_VENDOR_V2
	tristate "Touchscreens"
	default n
	help
	  Say Y here, and a list of supported touchscreens will be displayed.
	  This option doesn't affect the kernel.

	  If unsure, say n.

source "drivers/vendor/common/touchscreen_v2/goodix_berlin_driver_v2/Kconfig"
source "drivers/vendor/common/touchscreen_v2/goodix_berlin_driver_v3/Kconfig"
source "drivers/vendor/common/touchscreen_v2/goodix_berlin_driver_THP/Kconfig"
source "drivers/vendor/common/touchscreen_v2/chipone_tddi_v2_1/Kconfig"
source "drivers/vendor/common/touchscreen_v2/chipone_tddi_v3/Kconfig"
source "drivers/vendor/common/touchscreen_v2/chipone_tddi_pad/Kconfig"
source "drivers/vendor/common/touchscreen_v2/chsc5xxx/Kconfig"
source "drivers/vendor/common/touchscreen_v2/eswin_touch/Kconfig"
source "drivers/vendor/common/touchscreen_v2/ilitek_tddi_v3/Kconfig"
source "drivers/vendor/common/touchscreen_v2/ilitek_tddi_v3_1/Kconfig"
source "drivers/vendor/common/touchscreen_v2/focaltech_touch_v4_1/Kconfig"
source "drivers/vendor/common/touchscreen_v2/focaltech_touch_v4_2/Kconfig"
source "drivers/vendor/common/touchscreen_v2/focaltech_touch_v4_3/Kconfig"
source "drivers/vendor/common/touchscreen_v2/focaltech_touch_ufp_v4_1/Kconfig"
source "drivers/vendor/common/touchscreen_v2/focaltech_touch_pad/Kconfig"
source "drivers/vendor/common/touchscreen_v2/tlsc6x_v3/Kconfig"
source "drivers/vendor/common/touchscreen_v2/gcore_ts_v3/Kconfig"
source "drivers/vendor/common/touchscreen_v2/gcore_gc7272_spi/Kconfig"
source "drivers/vendor/common/touchscreen_v2/betterlife_ts/Kconfig"
source "drivers/vendor/common/touchscreen_v2/sitronix_incell/Kconfig"
source "drivers/vendor/common/touchscreen_v2/sitronix_incell_v2/Kconfig"
source "drivers/vendor/common/touchscreen_v2/novatek_touch_spi/Kconfig"
source "drivers/vendor/common/touchscreen_v2/omnivision_tcm/Kconfig"
source "drivers/vendor/common/touchscreen_v2/hxchipset_v3_3/Kconfig"
source "drivers/vendor/common/touchscreen_v2/hxchipset_pad/Kconfig"
source "drivers/vendor/common/touchscreen_v2/axs_touch/Kconfig"

config TOUCHSCREEN_BOARD_NAME
	string "config board firmware folder"

config TOUCHSCREEN_DRM_PANEL_NOTIFIER
	bool "add qcom drm panel support"
	default n
	help
	  Say Y here to enable debug tools.

	  If unsure, say N.

config TOUCHSCREEN_UFP_MAC
	bool "tp under fingerprint status machine"
	default n
	help
	  Say Y here if you want to have a under fingerprint status machine
	  If unsure, say N.

config TOUCHSCREEN_POINT_REPORT_CHECK
	bool "all point clean when tp irq timeout"
	default n
	help
	  Say Y here to enable .
	  If unsure, say N.

config TOUCHSCREEN_ZTE_ESD_CHECK
	bool "tp esd check"
	default n
	help
	  Say Y here to enable .
	  If unsure, say N.

config TOUCHSCREEN_POINT_SIMULAT_UF
 	bool "tp under fingerprint status machine"
 	default n
	depends on TOUCHSCREEN_UFP_MAC
 	help
 	  Say Y here if you want to simulate finger down
 	  If unsure, say N.
config TOUCHSCREEN_LCD_NOTIFY
 	bool "lcd state notify"
 	default n
 	help
 	  Say Y here if you use lcd notify tp suspend/resume.If unsure, say N.
config TOUCHSCREEN_LCD_SUPPORT_PSENSOR
 	bool "incell tp promixity mode"
 	default n
	depends on TOUCHSCREEN_LCD_NOTIFY
 	help
 	  Say Y here if you use incell tp promixity mode.If unsure, say N.
config TOUCHSCREEN_PSENSOR_REPORT_CHECK
	bool "tp promixity mode report near and far"
	default n
	help
	  Say Y here if you use tp promixity mode.If unsure, say N.
config TOUCHSCREEN_TEMP_CTRL_ZONE_NOTIFY
 	bool "temperature control zone down/up notify"
 	default n
	depends on TOUCHSCREEN_VENDOR_V3
 	help
 	  Say Y here if you use temperature control zone down/up notify.If unsure, say N.
config TOUCHSCREEN_KNUCKLE
 	bool "knuckle algo"
 	default n
 	help
 	  Say Y here if you use knuckle algo.If unsure, say N.
config USE_QOCM_THP_CODE
	bool "use qcom some code"
	default n
	help
	  Say Y here if you use qcom some code.If unsure, say N.
config TP_GET_LCD_ID
	bool "tp use lcd id"
	default n
	help
	  Say Y here if you use lcd id.If unsure, say N.
config ZTE_LCD_TPD_INFO_FROM_LK
	bool "read zte-lcd-tpd-info-from-lk node"
	default n
	help
	  Say Y here if you use lcd id.If unsure, say N.
config NOT_USE_LCD_INFO
	bool "not use lcd info"
	default n
	help
	  Say Y here if you use lcd id.If unsure, say N.
config USE_TP_VOLTAGE_C_EN_GPIO
	bool "use_tp_voltage_c_en_gpio"
	default n
	help
	  Say Y here if you use lcd id.If unsure, say N.
config ZTE_LDD_TP_OPS
	bool "use_zte_ldd_tp_ops"
	default n
	help
	  Say Y here if you use lcd id.If unsure, say N.
```

## zte-kernel/drivers/vendor/common/touchscreen_v2/axs_touch/Kconfig
```kconfig
#
# AXS Touchscreen driver configuration
#

config TOUCHSCREEN_AXS_TOUCH
    bool "AXS Touchscreen"
    default n
    help
      Say Y here if you have AXS touch panel.
      If unsure, say N.


    
```

## zte-kernel/drivers/vendor/common/touchscreen_v2/eswin_touch/Kconfig
```kconfig
#
# ESWIN_TOUCH touchscreen driver configuration
#

config TOUCHSCREEN_ESWIN_TOUCH
	bool "eswin_touch"
	default n
	help
	  Say Y here if you have eswin_touch
	  to your system

	  If unsure, say N.

config TOUCHSCREEN_ESWIN_TOUCH_I2C
	bool "I2C"
	default n
	help
	  Say Y here to use I2C method

	  If unsure, say N

config TOUCHSCREEN_ESWIN_TOUCH_SPI
	bool "SPI"
	default n
	help
	  Say Y here to use SPI method

	  If unsure, say N
```

## zte-kernel/drivers/vendor/common/touchscreen_v2/focaltech_touch_pad/Kconfig
```kconfig
#
# Focaltech Touchscreen driver configuration
#

config TOUCHSCREEN_FOCALTECH_TOUCH_PAD
    tristate "Focaltech Touchscreen"
    default n
    help
      Say Y here if you have Focaltech touch panel.
      If unsure, say N.
```

## zte-kernel/drivers/vendor/common/touchscreen_v2/focaltech_touch_v4_1/Kconfig
```kconfig
#
# Focaltech Touchscreen driver configuration
#

config TOUCHSCREEN_FOCALTECH_TOUCH_V4_1
    tristate "Focaltech Touchscreen"
    default n
    help
      Say Y here if you have Focaltech touch panel.
      If unsure, say N.
```

## zte-kernel/drivers/vendor/common/touchscreen_v2/focaltech_touch_v4_2/Kconfig
```kconfig
#
# Focaltech Touchscreen driver configuration
#

config TOUCHSCREEN_FOCALTECH_TOUCH_V4_2
    bool "Focaltech Touchscreen spi driver"
    default n
    help
      Say Y here if you have Focaltech touch panel.
      If unsure, say N.
```

## zte-kernel/drivers/vendor/common/touchscreen_v2/focaltech_touch_v4_3/Kconfig
```kconfig
#
# Focaltech Touchscreen driver configuration
#

config TOUCHSCREEN_FOCALTECH_TOUCH_V4_3
    tristate "Focaltech Touchscreen"
    default n
    help
      Say Y here if you have Focaltech touch panel.
      If unsure, say N.
```

## zte-kernel/drivers/vendor/common/touchscreen_v2/gcore_gc7272_spi/Kconfig
```kconfig
#
# GCORE_V3 Touchscreen driver configuration
#

config TOUCHSCREEN_GCORE_GC7272_SPI
	bool "gcore Touchscreen"
		default n
		help
		  Say Y here if you have gcore touch panel.
		  If unsure, say N.
```

## zte-kernel/drivers/vendor/common/touchscreen_v2/goodix_berlin_driver_THP/Kconfig
```kconfig
#
# Goodix touchscreen driver configuration
#
menuconfig TOUCHSCREEN_GOODIX_BERLIN_DRIVER_THP
        bool "Goodix berlin touchscreen"
        default n
        help
          Say Y here if you have a Goodix berlin touch controller
          to your system.
```

## zte-kernel/drivers/vendor/common/touchscreen_v2/goodix_berlin_driver_v3/Kconfig
```kconfig
#
# Goodix touchscreen driver configuration
#
menuconfig TOUCHSCREEN_GOODIX_BERLIN_DRIVER_V3
	bool "Goodix berlin touchscreen"
	default n
	help
	  Say Y here if you have a Goodix berlin series touch controller
	  to your system.

	  If build module, say M.
	  If unsure, say N.

if TOUCHSCREEN_GOODIX_BERLIN_DRIVER_V3

config TOUCHSCREEN_GOODIX_BERLIN_DRIVER_V3_I2C
	bool "support I2C bus connection"
	depends on I2C
	default n
	help
	  Say Y here if the touchscreen is connected via I2C bus.

config TOUCHSCREEN_GOODIX_BERLIN_DRIVER_V3_SPI
	bool "support SPI bus connection"
	default n
	help
		Say Y here if the touchscreen is connected via SPI bus.

endif
```

## zte-kernel/drivers/vendor/common/touchscreen_v2/ilitek_tddi_v3_1/Kconfig
```kconfig
#
# Iltek Touchscreen driver configuration
#

config TOUCHSCREEN_ILITEK_TDDI_V3_1
	bool "ilitek tddi 9881xk Touchscreen"
	default n
	help
	Say Y here if you have ilitek touch panel.

if TOUCHSCREEN_ILITEK_TDDI_V3_1
config TOUCHSCREEN_ILITEK_TDDI_V3_1_I2C
	bool "Ilitek I2C Touchscreen"
	depends on I2C
	default n
	help
	Say Y here if you have ilitek i2c touch panel.

config TOUCHSCREEN_ILITEK_TDDI_V3_1_SPI
	bool "Ilitek spi Touchscreen"
	depends on SPI
	default n
	help
	Say Y here if you have ilitek spi touch panel.
endif
```

## zte-kernel/drivers/vendor/common/whs3844/Kconfig
```kconfig
#
# WHS3844 USB3 Redriver configuration
#

config USB_WHS3844
	tristate "WHS3844 USB3 Redriver"
	help
	  Say Y here to enable the WHS3844 USB3.0 Redriver
```
